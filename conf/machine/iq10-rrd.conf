## conf/machine/iq10-rrd.conf
```bitbake
#@TYPE: Machine
#@NAME: Qualcomm IQ10-RRD
#@DESCRIPTION: Machine configuration for Qualcomm IQ10-RRD

require conf/machine/include/qcom-nord.inc

MACHINE_FEATURES += "efi pci"

KERNEL_DEVICETREE ?= " \
                      qcom/iq10-rrd.dtb \
                      qcom/sa8797p-ride.dtb \
                      "

MACHINE_ESSENTIAL_EXTRA_RRECOMMENDS += " \
    packagegroup-iq10-rrd-firmware \
    packagegroup-iq10-rrd-hexagon-dsp-binaries \
"

QCOM_CDT_FILE = "cdt_nord_ridesx_0.1.0"
QCOM_BOOT_FILES_SUBDIR = "nord"
QCOM_PARTITION_FILES_SUBDIR ?= "partitions/iq10-rrd/ufs"

QCOM_BOOT_FIRMWARE = "firmware-qcom-boot-nord"
QCOM_CDT_FIRMWARE = "firmware-qcom-cdt-nord"
```
